## CMakeLists.txt
```
cmake_minimum_required(VERSION 3.20.0)

set(PRJ_ROOT ${CMAKE_CURRENT_SOURCE_DIR}/../..)

list(APPEND BOARD_ROOT ${PRJ_ROOT})
list(APPEND DTS_ROOT   ${PRJ_ROOT})

find_package(Zephyr REQUIRED HINTS $ENV{ZEPHYR_BASE})
project(ltc4281_hotswap_controller)

target_sources(app PRIVATE
    src/main.cpp
    src/adc_utils.c
    src/tmp101_utils.c
    src/hotswap_controller.cpp
    src/led_utils.c
    ${PRJ_ROOT}/drivers/ltc4281/ltc4281.c
)

target_include_directories(app PRIVATE ${PRJ_ROOT}/drivers/ltc4281)
```

## prj.conf
```kconfig
CONFIG_GPIO=y
CONFIG_I2C=y
CONFIG_PRINTK=y
CONFIG_ADC=y
CONFIG_SENSOR=y
CONFIG_LOG=y
CONFIG_CPP=y
CONFIG_STD_CPP17=y
CONFIG_LOG_DEFAULT_LEVEL=3
```

## src/main.c
```c
#include <zephyr/kernel.h>
#include <zephyr/sys/printk.h>

#include "adc_utils.h"

int main(void) {
    int32_t vin, vout;

    if (adc_setup()) {
        printk("ADC setup failed\n");
        return -1;
    }

    while (1) {
        if (adc_vin_mon(&vin) == 0 && adc_vout_mon(&vout) == 0) {
            printk("VIN = %d mV  VOUT = %d mV\n", vin, vout);
        } else {
            printk("ADC read failed\n");
        }
        k_msleep(1000);
    }

    return 0;
}
```

## src/main.cpp
```c
#include "adc_utils.h"
#include "hotswap_controller.hpp"
#include "tmp101_utils.h"
#include <zephyr/kernel.h>
#include <zephyr/logging/log.h>

LOG_MODULE_REGISTER(app, LOG_LEVEL_INF);

static HotswapController hotswap;

static void app_init() {
    if (hotswap.Init() < 0) {
        LOG_ERR("Hotswap init failed");
    }
}

static void app_run() {

    int32_t vin, vout, temp;

    if (hotswap.GetVinMv(&vin) == 0) {
        LOG_INF("VIN:  %d mV", vin);
    }

    if (hotswap.GetVoutMv(&vout) == 0) {
        LOG_INF("VOUT: %d mV", vout);
    }

    if (hotswap.GetTempC(&temp) == 0) {
        LOG_INF("TEMP: %d C", temp);
    }

    k_sleep(K_MSEC(1000));
}

int main(void) {
    app_init();

    while (1) {
        app_run();
    }

    return 0;
}
```

## src/adc_utils.c
```c
#include "adc_utils.h"

#include <errno.h>
#include <zephyr/drivers/adc.h>
#include <zephyr/logging/log.h>

LOG_MODULE_REGISTER(adc_utils, LOG_LEVEL_INF);

#define VIN_DIV_FULL_OHMS 101000  /* R69 91K + R70 10K */
#define VIN_DIV_OUT_OHMS 10000    /* R70 */
#define VOUT_DIV_FULL_OHMS 101000 /* R67 91K + R68 10K */
#define VOUT_DIV_OUT_OHMS 10000   /* R68 */

#define ADC_SAMPLES 8

static const struct adc_dt_spec vin_adc =
    ADC_DT_SPEC_GET_BY_NAME(DT_PATH(zephyr_user), vin);
static const struct adc_dt_spec vout_adc =
    ADC_DT_SPEC_GET_BY_NAME(DT_PATH(zephyr_user), vout);

static int adc_read_mv(const struct adc_dt_spec *spec, int32_t full,
                       int32_t out, int32_t *mv) {
    int16_t raw;
    int32_t sum = 0;
    struct adc_sequence seq = {
        .buffer = &raw,
        .buffer_size = sizeof(raw),
    };
    int ret;

    /* SAM0: setup selects the input mux, so do it before every read */
    ret = adc_channel_setup_dt(spec);
    if (ret) {
        LOG_ERR("ch%d: channel setup failed: %d", spec->channel_id, ret);
        return ret;
    }

    ret = adc_sequence_init_dt(spec, &seq);
    if (ret) {
        LOG_ERR("ch%d: sequence init failed: %d", spec->channel_id, ret);
        return ret;
    }

    /* Discard first sample after mux switch */
    ret = adc_read_dt(spec, &seq);
    if (ret) {
        LOG_ERR("ch%d: dummy read failed: %d", spec->channel_id, ret);
        return ret;
    }

    for (int i = 0; i < ADC_SAMPLES; i++) {
        ret = adc_read_dt(spec, &seq);
        if (ret) {
            LOG_ERR("ch%d: read %d failed: %d", spec->channel_id, i, ret);
            return ret;
        }
        sum += (raw < 0) ? 0 : raw;
    }

    int32_t val = sum / ADC_SAMPLES;

    LOG_DBG("ch%d: raw avg %d", spec->channel_id, val);

    ret = adc_raw_to_millivolts_dt(spec, &val);
    if (ret) {
        LOG_ERR("ch%d: raw to mV failed: %d", spec->channel_id, ret);
        return ret;
    }

    *mv = (int32_t)(((int64_t)val * full) / out);

    LOG_DBG("ch%d: pin %d mV, scaled %d mV", spec->channel_id, val, *mv);
    return 0;
}

int adc_setup(void) {
    if (!adc_is_ready_dt(&vin_adc)) {
        LOG_ERR("VIN ADC not ready");
        return -ENODEV;
    }

    if (!adc_is_ready_dt(&vout_adc)) {
        LOG_ERR("VOUT ADC not ready");
        return -ENODEV;
    }

    LOG_INF("ADC ready");
    return 0;
}

int adc_vin_mon(int32_t *mv) {
    return adc_read_mv(&vin_adc, VIN_DIV_FULL_OHMS, VIN_DIV_OUT_OHMS, mv);
}

int adc_vout_mon(int32_t *mv) {
    return adc_read_mv(&vout_adc, VOUT_DIV_FULL_OHMS, VOUT_DIV_OUT_OHMS, mv);
}
```

## src/adc_utils.h
```c
#ifndef ADC_UTILS_H_
#define ADC_UTILS_H_

#include <stdint.h>

#ifdef __cplusplus
extern "C" {
#endif

int adc_setup(void);
int adc_vin_mon(int32_t *mv);
int adc_vout_mon(int32_t *mv);

#ifdef __cplusplus
}
#endif

#endif /* ADC_UTILS_H_ */
```

## src/hotswap_controller.cpp
```c
// HotswapController.cpp
#include "hotswap_controller.hpp"
#include "adc_utils.h"
#include "tmp101_utils.h"
#include <errno.h>
#include <stdlib.h>
#include <zephyr/drivers/gpio.h>
#include <zephyr/kernel.h>
#include <zephyr/logging/log.h>

LOG_MODULE_REGISTER(hotswap, LOG_LEVEL_DBG);

static const struct gpio_dt_spec hs_on =
    GPIO_DT_SPEC_GET(DT_PATH(zephyr_user), hs_on_gpios); /* hotswap ON/OFF */

static const struct gpio_dt_spec cfg_pins[3] = {
    GPIO_DT_SPEC_GET_BY_IDX(DT_PATH(zephyr_user), cfg_gpios,
                            0), /* CFG0 - PA15 */
    GPIO_DT_SPEC_GET_BY_IDX(DT_PATH(zephyr_user), cfg_gpios,
                            1), /* CFG1 - PA14 */
    GPIO_DT_SPEC_GET_BY_IDX(DT_PATH(zephyr_user), cfg_gpios,
                            2), /* CFG2 - PA13 */
};

#define CFG_LOW_POWER 0b001  /* CFG0 high, CFG1 low,  CFG2 low */
#define CFG_HIGH_POWER 0b010 /* CFG0 low,  CFG1 high, CFG2 low */

int HotswapController::Init() {

    if (adc_setup() < 0) {
        LOG_ERR("ADC setup failed");
    }

    if (tmp101_setup() < 0) {
        LOG_ERR("TMP101 setup failed");
    }

    if (!gpio_is_ready_dt(&hs_on)) {
        LOG_ERR("HS_ON GPIO not ready");
        return -ENODEV;
    }

    int ret = gpio_pin_configure_dt(&hs_on, GPIO_OUTPUT_INACTIVE);
    if (ret < 0) {
        LOG_ERR("HS_ON config failed (%d)", ret);
        return ret;
    }

    LOG_INF("Hotswap controller initialized (OFF)");
    return 0;
}

int HotswapController::EnableHotswap() {
    int ret = gpio_pin_set_dt(&hs_on, 1);
    if (ret < 0) {
        LOG_ERR("Failed to turn hotswap ON (%d)", ret);
        return ret;
    }
    LOG_INF("Hotswap ON");
    return 0;
}

int HotswapController::DisableHotswap() {
    int ret = gpio_pin_set_dt(&hs_on, 0);
    if (ret < 0) {
        LOG_ERR("Failed to turn hotswap OFF (%d)", ret);
        return ret;
    }
    LOG_INF("Hotswap OFF");
    return 0;
}

int HotswapController::GetVinMv(int32_t *vin_mv) {
    int32_t mv;

    int ret = adc_vin_mon(&mv);
    if (ret < 0) {
        LOG_ERR("VIN read failed (%d)", ret);
        return ret;
    }

    LOG_DBG("VIN: %d mV", mv);
    *vin_mv = mv;
    return 0;
}

int HotswapController::GetVoutMv(int32_t *vout_mv) {
    int32_t mv;

    int ret = adc_vout_mon(&mv);
    if (ret < 0) {
        LOG_ERR("VOUT read failed (%d)", ret);
        return ret;
    }

    LOG_DBG("VOUT: %d mV", mv);
    *vout_mv = mv;
    return 0;
}

int HotswapController::GetTempC(int32_t *temp_c) {
    int32_t temp_mc;

    int ret = tmp101_read(&temp_mc);
    if (ret < 0) {
        LOG_ERR("Temp read failed (%d)", ret);
        return ret;
    }

    int32_t whole = temp_mc / 1000;
    int32_t tenth = abs(temp_mc % 1000) / 100;

    LOG_DBG("Temp: %s%d.%d °C", (temp_mc < 0 && whole == 0) ? "-" : "", whole,
            tenth);

    *temp_c = whole;
    return 0;
}

int HotswapController::DetectPowerMode() {
    int cfg = 0;

    for (int i = 0; i < 3; i++) {
        if (!gpio_is_ready_dt(&cfg_pins[i])) {
            LOG_ERR("CFG%d GPIO device not ready", i);
            return -ENODEV;
        }

        int ret = gpio_pin_configure_dt(&cfg_pins[i], GPIO_INPUT);
        if (ret < 0) {
            LOG_ERR("CFG%d configure failed (%d)", i, ret);
            return ret;
        }

        int bit = gpio_pin_get_dt(&cfg_pins[i]);
        if (bit < 0) {
            LOG_ERR("CFG%d read failed (%d)", i, bit);
            return bit;
        }

        LOG_DBG("CFG%d (PA%d) = %s", i, cfg_pins[i].pin, bit ? "HIGH" : "LOW");
        cfg |= (bit << i);
    }

    switch (cfg) {
    case CFG_LOW_POWER:
        LOG_INF("Board config: LOW power (CFG2..0 = 0x%x)", cfg);
        return LOW_POWER;

    case CFG_HIGH_POWER:
        LOG_INF("Board config: HIGH power (CFG2..0 = 0x%x)", cfg);
        return HIGH_POWER;

    default:
        LOG_WRN("Unknown board config: CFG2..0 = %d%d%d", (cfg >> 2) & 1,
                (cfg >> 1) & 1, cfg & 1);
        return -EINVAL;
    }
}
```

## src/hotswap_controller.hpp
```c
#ifndef HOTSWAP_CONTROLLER_HPP
#define HOTSWAP_CONTROLLER_HPP

#include <stdint.h>

class HotswapController {
  public:
    enum PowerMode {
        LOW_POWER = 0,
        HIGH_POWER = 1,
    };
    HotswapController() = default;
    int Init();
    int EnableHotswap();
    int DisableHotswap();
    int GetVinMv(int32_t *vin_mv);
    int GetVoutMv(int32_t *vout_mv);
    int GetTempC(int32_t *temp_c);
    int DetectPowerMode();
};

#endif /* HOTSWAP_CONTROLLER_HPP */
```

## src/led_utils.c
```c
#include "led_utils.h"

#include <zephyr/drivers/gpio.h>
#include <zephyr/kernel.h>
#include <zephyr/logging/log.h>
#include <zephyr/sys/atomic.h>

LOG_MODULE_REGISTER(leds, LOG_LEVEL_INF);

#define LED_TICK_MS 100
#define SLOW_TICKS 5
#define FAST_TICKS 1

enum led_id { LED_RED, LED_ORANGE, LED_GREEN, LED_NUM };
enum led_mode { M_OFF, M_ON, M_SLOW, M_FAST };

static const struct gpio_dt_spec leds[LED_NUM] = {
    [LED_RED] = GPIO_DT_SPEC_GET(DT_NODELABEL(led_red), gpios),
    [LED_ORANGE] = GPIO_DT_SPEC_GET(DT_NODELABEL(led_orange), gpios),
    [LED_GREEN] = GPIO_DT_SPEC_GET(DT_NODELABEL(led_green), gpios),
};

static const uint8_t patterns[LED_PATTERN_COUNT][LED_NUM] = {
    [LED_PATTERN_OFF] = {M_OFF, M_OFF, M_OFF},
    [LED_PATTERN_WAIT_POWER] = {M_OFF, M_SLOW, M_OFF},
    [LED_PATTERN_STARTING] = {M_OFF, M_ON, M_OFF},
    [LED_PATTERN_RUNNING] = {M_OFF, M_OFF, M_ON},
    [LED_PATTERN_WARNING] = {M_OFF, M_SLOW, M_ON},
    [LED_PATTERN_FAULT] = {M_ON, M_OFF, M_OFF},
    [LED_PATTERN_LOCKOUT] = {M_FAST, M_OFF, M_OFF},
    [LED_PATTERN_CONFIG_ERROR] = {M_SLOW, M_SLOW, M_OFF},
};

static atomic_t current_pattern = ATOMIC_INIT(LED_PATTERN_OFF);
static uint32_t tick;

static void led_timer_handler(struct k_timer *timer) {
    ARG_UNUSED(timer);

    enum led_pattern p = (enum led_pattern)atomic_get(&current_pattern);
    bool slow_on = ((tick / SLOW_TICKS) & 1U) != 0U;
    bool fast_on = ((tick / FAST_TICKS) & 1U) != 0U;

    tick++;

    for (int i = 0; i < LED_NUM; i++) {
        bool on;

        switch (patterns[p][i]) {
        case M_ON:
            on = true;
            break;
        case M_SLOW:
            on = slow_on;
            break;
        case M_FAST:
            on = fast_on;
            break;
        default:
            on = false;
            break;
        }
        gpio_pin_set_dt(&leds[i], on ? 1 : 0);
    }
}

K_TIMER_DEFINE(led_timer, led_timer_handler, NULL);

int leds_init(void) {
    for (int i = 0; i < LED_NUM; i++) {
        if (!gpio_is_ready_dt(&leds[i])) {
            LOG_ERR("LED %d GPIO not ready", i);
            return -ENODEV;
        }

        int ret = gpio_pin_configure_dt(&leds[i], GPIO_OUTPUT_INACTIVE);
        if (ret < 0) {
            LOG_ERR("LED %d config failed (%d)", i, ret);
            return ret;
        }
    }

    k_timer_start(&led_timer, K_NO_WAIT, K_MSEC(LED_TICK_MS));
    return 0;
}

void leds_set_pattern(enum led_pattern pattern) {
    if (pattern < LED_PATTERN_COUNT) {
        atomic_set(&current_pattern, pattern);
    }
}
```

## src/led_utils.h
```c
#ifndef LED_UTILS_H_
#define LED_UTILS_H_

#ifdef __cplusplus
extern "C" {
#endif

enum led_pattern {
    LED_PATTERN_OFF,
    LED_PATTERN_WAIT_POWER,   /* orange slow blink */
    LED_PATTERN_STARTING,     /* orange on */
    LED_PATTERN_RUNNING,      /* green on */
    LED_PATTERN_WARNING,      /* green on + orange slow blink */
    LED_PATTERN_FAULT,        /* red on */
    LED_PATTERN_LOCKOUT,      /* red fast blink */
    LED_PATTERN_CONFIG_ERROR, /* red + orange slow blink */
    LED_PATTERN_COUNT
};

int leds_init(void);
void leds_set_pattern(enum led_pattern pattern);

#ifdef __cplusplus
}
#endif

#endif /* LED_UTILS_H_ */
```

## src/tmp101_utils.c
```c
#include "tmp101_utils.h"

#include <errno.h>
#include <stdbool.h>
#include <zephyr/device.h>
#include <zephyr/drivers/sensor.h>
#include <zephyr/logging/log.h>

LOG_MODULE_REGISTER(tmp101_utils, LOG_LEVEL_INF);

static const struct device *const tmp = DEVICE_DT_GET(DT_NODELABEL(tmp101));

static bool tmp_ready;

int tmp101_setup(void) {
    tmp_ready = device_is_ready(tmp);
    if (!tmp_ready) {
        LOG_ERR("TMP101 not ready");
        return -ENODEV;
    }

    LOG_INF("TMP101 ready");
    return 0;
}

int tmp101_read(int32_t *temp_mc) {
    struct sensor_value val;
    int ret;

    if (!tmp_ready) {
        return -ENODEV;
    }

    ret = sensor_sample_fetch(tmp);
    if (ret) {
        LOG_ERR("sample fetch failed: %d", ret);
        return ret;
    }

    ret = sensor_channel_get(tmp, SENSOR_CHAN_AMBIENT_TEMP, &val);
    if (ret) {
        LOG_ERR("channel get failed: %d", ret);
        return ret;
    }

    *temp_mc = (int32_t)sensor_value_to_milli(&val);
    LOG_DBG("temp: %d mC", *temp_mc);
    return 0;
}
```

## src/tmp101_utils.h
```c
#ifndef TMP101_UTILS_H
#define TMP101_UTILS_H

#include <stdint.h>

#ifdef __cplusplus
extern "C" {
#endif

int tmp101_setup(void);
int tmp101_read(int32_t *temp_mc);

#ifdef __cplusplus
}
#endif

#endif /* TMP101_UTILS_H */
```
