## boards/custom/samc21j_little_brain/Kconfig.samc21j_little_brain
```kconfig
# Copyright (c) 2022 Kamil Serwus
# Copyright (c) 2024 Gerson Fernando Budke <nandojve@gmail.com>
# SPDX-License-Identifier: Apache-2.0

config BOARD_SAMC21J_LITTLE_BRAIN
	select SOC_SAMC21N18A
```

## boards/custom/samc21j_little_brain/board.yml
```yaml
board:
  name: samc21j_little_brain
  full_name: SAM C21J MCU Little brain
  vendor: custom
  socs:
    - name: samc21n18a
```

## boards/custom/same51j_hotswap_controller/board.yml
```yaml
board:
  name: same51j_hotswap_controller
  full_name: LTC4281 Hot Swap Controller
  vendor: custom
  socs:
    - name: same51j19a
```

## manifest/west.yml
```yaml
manifest:
  remotes:
    - name: zephyrproject
      url-base: https://github.com/zephyrproject-rtos
  projects:
    - name: zephyr
      repo-path: zephyr
      remote: zephyrproject
      import:
        path-prefix: deps
        name-allowlist:
          - cmsis_6
          - percepio
          - picolibc
          - mcuboot
          - trusted-firmware-m
          - segger
          - mbedtls
          - tf-psa-crypto
          - hal_microchip
          - hal_atmel
      revision: v4.4.2
  self:
    path: manifest
```
